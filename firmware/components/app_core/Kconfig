## firmware/components/app_core/Kconfig
```kconfig
menu "app_core component"

config APP_CORE_ENABLED
    bool "Enable app_core component"
    default y

endmenu
```

## firmware/components/board/Kconfig
```kconfig
menu "board component"

config BOARD_ENABLED
    bool "Enable board component"
    default y

endmenu
```

## firmware/components/connectivity/Kconfig
```kconfig
menu "connectivity component"

config CONNECTIVITY_ENABLED
    bool "Enable connectivity component"
    default y

endmenu
```

## firmware/components/console_cli/Kconfig
```kconfig
menu "console_cli component"

config CONSOLE_CLI_ENABLED
    bool "Enable console_cli component"
    default y

endmenu
```

## firmware/components/dali/Kconfig
```kconfig
menu "dali component"

config DALI_ENABLED
    bool "Enable dali component"
    default y

endmenu
```

## firmware/components/diagnostics/Kconfig
```kconfig
menu "diagnostics component"

config DIAGNOSTICS_ENABLED
    bool "Enable diagnostics component"
    default y

endmenu
```

## firmware/components/drivers/Kconfig
```kconfig
menu "drivers component"

config DRIVERS_ENABLED
    bool "Enable drivers component"
    default y

endmenu
```

## firmware/components/ota/Kconfig
```kconfig
menu "ota component"

config OTA_ENABLED
    bool "Enable ota component"
    default y

endmenu
```

## firmware/components/product_logic/Kconfig
```kconfig
menu "product_logic component"

config PRODUCT_LOGIC_ENABLED
    bool "Enable product_logic component"
    default y

endmenu
```

## firmware/components/storage/Kconfig
```kconfig
menu "storage component"

config STORAGE_ENABLED
    bool "Enable storage component"
    default y

endmenu
```

## firmware/sdkconfig.defaults
```kconfig
CONFIG_PARTITION_TABLE_CUSTOM=y
CONFIG_PARTITION_TABLE_CUSTOM_FILENAME="partitions.csv"
CONFIG_ESPTOOLPY_FLASHSIZE_4MB=y
CONFIG_ESPTOOLPY_FLASHSIZE="4MB"
CONFIG_APP_PROJECT_VER_FROM_CONFIG=n
CONFIG_LOG_DEFAULT_LEVEL_INFO=y
CONFIG_ESP_TASK_WDT_EN=y
```
